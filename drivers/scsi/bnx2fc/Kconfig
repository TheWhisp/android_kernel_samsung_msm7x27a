## drivers/sensors/Kconfig
```kconfig
# 
# Sensors core device. 
#

config SENSORS_CORE
	tristate "Sensors core"
	help
	  Say Y here to enable debugging messages for power supply class
	  and drivers.

config SENSORS_HSCD
	depends on I2C
	tristate "hscd alps mag and bma222 accel"
	default n
	help
	  This option enables hscd alps mag and bma222 accel driver.

config PROXIMITY_SENSOR
	tristate "proximity_sensor"
	default n
	help
	  This option enables magnetic sensors using mmc328x magnetic driver.
```
